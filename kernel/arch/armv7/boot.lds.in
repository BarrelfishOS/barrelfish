/*
 * Copyright (c) 2007,2008,2016 ETH Zurich.
 * All rights reserved.
 *
 * This file is distributed under the terms in the attached LICENSE file.
 * If you do not find this file, copies can be found by writing to:
 * ETH Zurich D-INFK, Haldeneggsteig 4, CH-8092 Zurich. Attn: Systems Group.
 */

#include <offsets.h>

OUTPUT_FORMAT("elf32-littlearm")
OUTPUT_ARCH("arm")

ENTRY(start)

PHDRS
{
    load PT_LOAD;
}

SECTIONS {
    . = 0;

    . = ALIGN(4k);
    boot_start = .;

    /* The page tables need a larger alignment. */
    . = ALIGN(16k);
    .boot . :
    {
        *(.boot.tables);
        *(.boot);
    } :load

    boot_text_start = .;

    .text : {
        *(.text);
        *(.text.unlikely);
    }

    boot_text_end = .;

    .rodata . :
    {
        *(.rodata);
        *(.rodata.*);
    }

    .got . :
    {
        got_base = .;
        *(.got);
        *(.got.plt);
    }

    .data . :
    {
        *(.data);
        *(.data.*);
    }

    .bss . :
    {
        *(.bss);
    }

    .note.gnu.build-id . :
    {
        *(.note.gnu.build-id);
    }

    .rel.dyn . :
    {
        *(.rel.dyn);
    }

    boot_end = .;

    /***** These sections get discarded *****/
    /DISCARD/ :
    {
        /* Discard exception handler frames and headers -- we don't use em */
        *(.eh_frame);
        *(.eh_frame_hdr);
        *(.interp);
        *(.dynamic); 
    }
}
